## boards/shields/narfbloq/Kconfig.defconfig
```kconfig
# Copyright (c) 2020 The ZMK Contributors
# SPDX-License-Identifier: MIT

if SHIELD_NARFBLOQ

config ZMK_KEYBOARD_NAME
    default "narfbloq"

endif
```

## boards/shields/narfbloq/Kconfig.shield
```kconfig
# Copyright (c) 2020 The ZMK Contributors
# SPDX-License-Identifier: MIT

config SHIELD_NARFBLOQ
	def_bool $(shields_list_contains,narfbloq)
```

## config/west.yml
```yaml
manifest:
  remotes:
    - name: zmkfirmware
      url-base: https://github.com/zmkfirmware
    # Additional modules containing boards/shields/custom code can be listed here as well
    # See https://docs.zephyrproject.org/3.2.0/develop/west/manifest.html#projects
  projects:
    - name: zmk
      remote: zmkfirmware
      revision: 9490391e1e4010c83291d437b7f9a71ace244581
      import: app/west.yml
  self:
    path: config
```
